## boards/arm/OMM_nrf52840/Kconfig.board
```kconfig
config BOARD_OMM_NRF52840
    bool "OMM nRF52840"
    depends on SOC_NRF52840_QIAA
```

## boards/arm/OMM_nrf52840/Kconfig.defconfig
```kconfig
if BOARD_OMM_NRF52840

config BOARD
    default "OMM_nrf52840"

if USB

config USB_NRFX
    default y

config USB_DEVICE_STACK
    default y

endif # USB

config BT_CTLR
    default BT

endif # BOARD_OMM_NRF52840
```

## boards/shields/OMM/Kconfig.defconfig
```kconfig
if SHIELD_OMM

config ZMK_KEYBOARD_NAME
    default "oh my Minila"

endif # SHIELD_OMM
```

## drivers/led/Kconfig
```kconfig
# SPDX-License-Identifier: MIT

config OMM_STATUS_LEDS
    bool "Enable OMM status LEDs"
    default y
    depends on BOARD_OMM_NRF52840
    depends on GPIO
    depends on ZMK_BATTERY
    help
      Drive D1 for low battery and D2 for BLE pairing status.

if OMM_STATUS_LEDS

config OMM_STATUS_LEDS_LOW_BATTERY_THRESHOLD
    int "OMM low battery LED threshold"
    default 20
    range 0 100
    help
      Turn on D1 when the reported battery state of charge is less than or
      equal to this percentage.

config OMM_STATUS_LEDS_PAIRING_BLINK_MS
    int "OMM pairing LED blink interval in milliseconds"
    default 500
    range 50 10000
    help
      Toggle D2 at this interval while the active BLE profile is open and not
      connected.

endif # OMM_STATUS_LEDS
```

## drivers/sensor/battery_aa2/Kconfig
```kconfig
# SPDX-License-Identifier: MIT

DT_COMPAT_OMM_BATTERY_AA2_VOLTAGE_DIVIDER := omm,battery-aa2-voltage-divider

config ZMK_BATTERY_AA2_VOLTAGE_DIVIDER
    bool
    default $(dt_compat_enabled,$(DT_COMPAT_OMM_BATTERY_AA2_VOLTAGE_DIVIDER))
    select ADC
    select ZMK_BATTERY
    depends on SENSOR
    help
      Enable two AA/AAA cell battery monitoring using a voltage divider.

if ZMK_BATTERY_AA2_VOLTAGE_DIVIDER

config ZMK_BATTERY_AA2_EMPTY_MV
    int "Two-cell dry battery empty voltage in millivolts"
    default 2000
    range 0 5000
    help
      Battery voltage reported as 0 percent state of charge.

config ZMK_BATTERY_AA2_FULL_MV
    int "Two-cell dry battery full voltage in millivolts"
    default 3200
    range 0 5000
    help
      Battery voltage reported as 100 percent state of charge.

endif # ZMK_BATTERY_AA2_VOLTAGE_DIVIDER
```

## dts/bindings/sensor/omm,battery-aa2-voltage-divider.yaml
```yaml
# SPDX-License-Identifier: MIT

description: Two AA/AAA cell battery SoC monitoring using voltage divider

compatible: "omm,battery-aa2-voltage-divider"

include: voltage-divider.yaml
```
